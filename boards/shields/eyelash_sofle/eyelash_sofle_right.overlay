/*
*
* Copyright (c) 2021 Darryl deHaan
* SPDX-License-Identifier: MIT
*
*/

#include "eyelash_sofle.dtsi"
#include <behaviors/battery_history_request.dtsi>

&kscan0 {
    compatible = "zmk,kscan-gpio-matrix";
    row-gpios
        = <&gpio0 19 (GPIO_ACTIVE_HIGH | GPIO_PULL_DOWN)>
        , <&gpio0 8 (GPIO_ACTIVE_HIGH | GPIO_PULL_DOWN)>
        , <&gpio0 12 (GPIO_ACTIVE_HIGH | GPIO_PULL_DOWN)>
        , <&gpio0 11 (GPIO_ACTIVE_HIGH | GPIO_PULL_DOWN)>
        , <&gpio1 9 (GPIO_ACTIVE_HIGH | GPIO_PULL_DOWN)>
        ;
    col-gpios
       = <&gpio0 22 GPIO_ACTIVE_HIGH>
        , <&gpio0 29 GPIO_ACTIVE_HIGH>
        , <&gpio0 3 GPIO_ACTIVE_HIGH>
        , <&gpio0 28 GPIO_ACTIVE_HIGH>
        , <&gpio0 30 GPIO_ACTIVE_HIGH>
        , <&gpio0 21 GPIO_ACTIVE_HIGH>
        , <&gpio0 23 GPIO_ACTIVE_HIGH>
        ;
};

&default_transform {
    col-offset = <7>;
};