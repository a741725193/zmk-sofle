/*
*
* Copyright (c) 2021 Darryl deHaan
* SPDX-License-Identifier: MIT
*
*/

#include "eyelash_sofle.dtsi"
#include <behaviors/battery_history_request.dtsi>
#include <input/processors.dtsi>
#include <input/processors/runtime-input-processor.dtsi>

&kscan0 {
     col-gpios
         = <&gpio0 3 GPIO_ACTIVE_HIGH>
         , <&gpio0 28 GPIO_ACTIVE_HIGH>
         , <&gpio0 30 GPIO_ACTIVE_HIGH>
         , <&gpio0 21 GPIO_ACTIVE_HIGH>
         , <&gpio0 23 GPIO_ACTIVE_HIGH>
         , <&gpio0 22 GPIO_ACTIVE_HIGH>
         ;
};

&left_encoder {
    status = "okay";
};

